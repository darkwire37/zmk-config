## boards/shields/fourby/Kconfig.defconfig
```kconfig
if SHIELD_FOURBY_LEFT

config ZMK_KEYBOARD_NAME
    default "fourby"

config ZMK_SPLIT_ROLE_CENTRAL
    default y

endif

if SHIELD_FORUBY_LEFT || SHIELD_FOURBY_RIGHT

config ZMK_SPLIT
    default y

endif
```

## boards/shields/fourby/Kconfig.shield
```kconfig
config SHIELD_FOURBY_LEFT
    def_bool $(shields_list_contains,fourby_left)

config SHIELD_FOURBY_RIGHT
    def_bool $(shields_list_contains,fourby_right)
```
